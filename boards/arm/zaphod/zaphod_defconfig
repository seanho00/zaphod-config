## boards/arm/zaphod/zaphod_defconfig
```kconfig
# SPDX-License-Identifier: MIT

CONFIG_SOC_SERIES_NRF52X=y
CONFIG_SOC_NRF52840_QIAA=y
CONFIG_BOARD_ZAPHOD=y

# Enable MPU
CONFIG_ARM_MPU=y

# enable GPIO
CONFIG_GPIO=y

CONFIG_ZMK_SLEEP=y

CONFIG_ZMK_DISPLAY=n
CONFIG_LV_USE_THEME_MONO=y
CONFIG_LV_COLOR_CHROMA_KEY_HEX=0x00FF00

CONFIG_USE_DT_CODE_PARTITION=y
CONFIG_BUILD_OUTPUT_UF2=y

CONFIG_MPU_ALLOW_FLASH_WRITE=y
CONFIG_NVS=y
CONFIG_SETTINGS_NVS=y
CONFIG_FLASH=y
CONFIG_FLASH_PAGE_LAYOUT=y
CONFIG_FLASH_MAP=y

# Custom
CONFIG_BT_CTLR_TX_PWR_PLUS_8=y
CONFIG_ZMK_IDLE_SLEEP_TIMEOUT=1800000
CONFIG_ZMK_KSCAN_DEBOUNCE_PRESS_MS=2
CONFIG_ZMK_KSCAN_DEBOUNCE_RELEASE_MS=10
CONFIG_ZMK_MOUSE=y
```

## west.yml
```yaml
# PR2027: https://github.com/petejohanson/zmk:feat/pointers-move-scroll
# bravekarma merge: https://github.com/caksoylar/zmk:caksoylar/experimental
manifest:
  projects:
    - name: zmk
      url: https://github.com/petejohanson/zmk
      revision: feat/pointers-move-scroll
      import: app/west.yml
      clone-depth: 1
  self:
    path: config
```
